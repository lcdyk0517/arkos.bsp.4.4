// SPDX-License-Identifier: (GPL-2.0+ OR MIT)
/*
* Copyright (c) 2025 kk&lcdyk
*
* 稀范科技 RF35H
*
*/

/dts-v1/;
#include "rk3326-xf35h-linux.dts"

/ {
	model = "XiFan RF35H";
	compatible = "rockchip,rk3326-rf35h-linux", "rockchip,rk3326";
};