// SPDX-License-Identifier: (GPL-2.0+ OR MIT)
/*
* Copyright (c) 2025 kk&lcdyk
*
* 稀范科技 DC40V
*
*/

/dts-v1/;
#include "rk3326-dc40v-linux.dts"

/ {
	model = "XiFan XF40V";
	compatible = "rockchip,rk3326-xf40v-linux", "rockchip,rk3326";
};