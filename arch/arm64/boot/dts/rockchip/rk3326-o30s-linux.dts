// SPDX-License-Identifier: (GPL-2.0+ OR MIT)
/*
* Copyright (c) 2026 kk&lcdyk
*
* GameConsole O30S
*
*/

/dts-v1/;
#include "rk3326-r36h-linux.dts"

/ {
	model = "GameConsole O30S";
	compatible = "rockchip,rk3326-o30s-linux", "rockchip,rk3326";
};