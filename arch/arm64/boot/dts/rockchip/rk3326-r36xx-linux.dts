// SPDX-License-Identifier: (GPL-2.0+ OR MIT)
/*
* Copyright (c) 2026 kk&lcdyk
*
* GameConsole R36S
*
*/

/dts-v1/;
#include "rk3326-r36s-panel4-type1-linux.dts"

/ {
	model = "GameConsole R36XX";
	compatible = "rockchip,rk3326-r36xx-linux", "rockchip,rk3326";
};